## conf/distro/tuxbox.conf
```bitbake
# Tuxbox-OS Distribution Configuration
#
# Distribution for Tuxbox-Neutrino (not Enigma2)
# Based on OE-Alliance infrastructure

require conf/distro/poky.conf

# Distribution identity
# Override poky defaults explicitly to avoid spaces/parentheses in imageversion
DISTRO = "tuxbox"
DISTRO_NAME = "Tuxbox-OS"
DISTRO_VERSION ?= "4.0.32"
DISTRO_CODENAME ?= "kirkstone"

# Maintainer
MAINTAINER = "Tuxbox Neutrino Team <team@tuxbox-neutrino.org>"

# Require MACHINE/MACHINEBUILD to be present (OE-A uses MACHINEBUILD for driver RDEPENDS)
MACHINEBUILD ??= ""
INHERIT += "machinebuild-check"
INHERIT += "tuxbox-flash-backend"

# Flash backend capability model (supported: script, ofgwrite)
TUXBOX_FLASH_BACKEND ?= "script"
# Temporary integration branch for unified, profile-driven flash-script runtime.
TUXBOX_FLASH_SCRIPT_GIT_BRANCH ?= "refactor/unified-profile-driven-flash"

# Runtime startup-slot switching is broader than the OE-A `fastboot` feature:
# some EMMC multiboot image classes provide STARTUP slot files without marking
# the machine as fastboot-capable.
TUXBOX_STARTUP_SWITCH_IMAGE_CLASSES ?= "hdemmc_image_multiboot airdigital-emmc_image_multiboot ceryonemmc_image_multiboot"
TUXBOX_STARTUP_SWITCH_CAPABLE ??= "${@'1' if (bb.utils.contains('MACHINE_FEATURES', 'fastboot', True, False, d) or bb.utils.contains_any('IMAGE_CLASSES', d.getVar('TUXBOX_STARTUP_SWITCH_IMAGE_CLASSES') or '', True, False, d)) else '0'}"

# Image artifact naming is related but not identical: Ceryon uses STARTUP slot
# files, but its brand packaging still emits `_usb.zip`.
TUXBOX_MULTI_IMAGE_SUFFIX_CLASSES ?= "hdemmc_image_multiboot airdigital-emmc_image_multiboot"

# Host distro validation (avoid sanity warnings on Debian 12)
SANITY_TESTED_DISTROS:append = " debian-12"

# Force git to use HTTP/1.1 to avoid HTTP/2 framing issues with some hosts
GIT_HTTP_VERSION = "1.1"

# Distribution features (NO Enigma2-specific features)
# For uClibc: use sysvinit instead of systemd (uClibc incompatibility)
DISTRO_FEATURES = "${@bb.utils.contains('TCLIBC', 'uclibc', '', 'systemd', d)} \
                   alsa \
                   bluetooth \
                   nfs \
                   zeroconf \
                   pam \
                   ipv4 \
                   ipv6 \
                   wifi \
                   largefile \
                   opengl \
                   usbhost \
                   usbgadget \
                   ext2 \
                   vfat \
                   "

# QEMU generic PC uses OpenGL/GLUT backend; enable X11 only for qemu machines
DISTRO_FEATURES:append:qemux86-64 = " x11"
DISTRO_FEATURES:append:qemux86 = " x11"

# For glibc: Remove sysvinit (use systemd exclusively)
# For uClibc: Remove systemd (use sysvinit instead)
DISTRO_FEATURES_BACKFILL_CONSIDERED += "${@bb.utils.contains('TCLIBC', 'uclibc', 'systemd', 'sysvinit', d)}"

# Virtual providers - Use Neutrino instead of Enigma2
PREFERRED_PROVIDER_virtual/egl ?= "mesa"
PREFERRED_PROVIDER_virtual/libgl ?= "mesa"
PREFERRED_PROVIDER_virtual/libgles2 ?= "mesa"
# Default to luajit for Neutrino Lua API, allow override in local.conf
PREFERRED_PROVIDER_virtual/lua ?= "luajit"
PREFERRED_PROVIDER_virtual/lua-native ?= "${@'luajit-native' if (d.getVar('PREFERRED_PROVIDER_virtual/lua') or '') == 'luajit' else 'lua-native' if (d.getVar('PREFERRED_PROVIDER_virtual/lua') or '') == 'lua' else ''}"
# Normalize the selected Lua provider for recipes that need provider-specific
# configure arguments or include paths.
TUXBOX_LUA_PROVIDER ?= "${@'luajit' if (d.getVar('PREFERRED_PROVIDER_virtual/lua') or '') == 'luajit' else 'lua' if (d.getVar('PREFERRED_PROVIDER_virtual/lua') or '') == 'lua' else 'auto'}"
PREFERRED_PROVIDER_virtual/libgbm:class-native = "mesa"
PREFERRED_PROVIDER_virtual/libgbm:class-nativesdk = "mesa"

# Prefer the tarball recipe to avoid AUTOREV git fetches.
PREFERRED_VERSION_libdvdcss ?= "1.4.3"
# Prefer the fixed SRCREV recipe over AUTOREV.
PREFERRED_VERSION_libdvbcsa ?= "1.1.0"
# Prefer tarball recipes for stable upstream releases.
PREFERRED_VERSION_libao ?= "1.2.0"
PREFERRED_VERSION_cdparanoia ?= "10.2"
# Prefer upstream libvpx to avoid older oe-alliance pin.
PREFERRED_VERSION_libvpx ?= "1.11.0"
PREFERRED_VERSION_libsdl2 = "2.0.20"

# Init system
# uClibc is not compatible with systemd, use sysvinit instead
VIRTUAL-RUNTIME_init_manager = "${@bb.utils.contains('TCLIBC', 'uclibc', 'sysvinit', 'systemd', d)}"
VIRTUAL-RUNTIME_initscripts = "${@bb.utils.contains('TCLIBC', 'uclibc', 'initscripts', 'systemd-compat-units', d)}"
VIRTUAL-RUNTIME_login_manager = "shadow-base"
VIRTUAL-RUNTIME_dev_manager = "${@bb.utils.contains('TCLIBC', 'uclibc', 'udev', 'systemd', d)}"

# Skip host SDK packagegroup to avoid pulling unusable nativesdk deps
TOOLCHAIN_HOST_TASK:remove = "nativesdk-packagegroup-sdk-host"

# Package management
PACKAGE_CLASSES ?= "package_ipk"
EXTRA_IMAGE_FEATURES ?= "debug-tweaks"
LICENSE_FLAGS_ACCEPTED:append = " commercial"



# Image naming
IMAGE_NAME ?= "${IMAGE_BASENAME}-${MACHINE}-${DATETIME}"
IMAGE_NAME[vardepsexclude] = "DATETIME"
IMAGE_VERSION ?= "${DISTRO_VERSION}"
IMAGE_NAME_SUFFIX ?= ".tuxbox"
# Use a space-free image version string so unquoted echoes in OA brand scripts don't break
IMAGE_VER_STRING ?= "${DISTRO_NAME}-${IMAGE_VERSION}-${MACHINEBUILD}-${DATE}"
IMAGE_VER_STRING[vardepsexclude] += "DATE"

# Optimization flags
# Default to size optimization
FULL_OPTIMIZATION = "-Os -pipe ${DEBUG_FLAGS}"

# Performance-critical packages get -O3
FULL_OPTIMIZATION:pn-flac = "-O3 -pipe ${DEBUG_FLAGS}"
FULL_OPTIMIZATION:pn-libogg = "-O3 -pipe ${DEBUG_FLAGS}"
FULL_OPTIMIZATION:pn-libvorbis = "-O3 -pipe ${DEBUG_FLAGS}"
FULL_OPTIMIZATION:pn-zlib = "-O3 -pipe ${DEBUG_FLAGS}"
FULL_OPTIMIZATION:pn-libpng = "-O3 -pipe ${DEBUG_FLAGS}"
FULL_OPTIMIZATION:pn-ffmpeg = "-O3 -pipe ${DEBUG_FLAGS}"
FULL_OPTIMIZATION:pn-gstreamer1.0 = "-O3 -pipe ${DEBUG_FLAGS}"

# Stability-critical packages get -O2
FULL_OPTIMIZATION:pn-systemd = "-O2 -pipe ${DEBUG_FLAGS}"
FULL_OPTIMIZATION:pn-busybox = "-O2 -pipe ${DEBUG_FLAGS}"
FULL_OPTIMIZATION:pn-openssl = "-O2 -pipe ${DEBUG_FLAGS}"

# Toolchain
TCLIBC ?= "glibc"
TCMODE ?= "default"

# Samba waf does not support --disable-static from no-static-libs.inc
DISABLE_STATIC:pn-samba = ""
EXTRA_OECONF:remove:pn-samba = "--disable-static"

# GCC configuration
GCCVERSION ?= "11.%"
SDKGCCVERSION ?= "${GCCVERSION}"

# Kernel
PREFERRED_PROVIDER_virtual/kernel ?= "linux-yocto"
PREFERRED_VERSION_linux-yocto ?= "5.15%"

# Include OE-Alliance shared configurations if available
include conf/distro/include/unstable-versions.inc

# Feed configuration
DISTRO_FEED_URI ?= "http://feed.tuxbox-neutrino.org/${DISTRO_VERSION}"
DISTRO_FEED_PREFIX ?= "tuxbox"

# Service Key (distro default).
# Shared read-token for the image portal service, keeps public endpoints
# unindexable.  Override in local.conf for public deployments.  Full
# contract: docs/SERVICE-KEY.md.
TUXBOX_SERVICE_KEY ?= "XXXXXXXXXXXXXXXX"

# SDK configuration
SDK_NAME = "${DISTRO}-${TCLIBC}-${SDKMACHINE}-${IMAGE_BASENAME}-${TUNE_PKGARCH}-${MACHINE}"
SDKPATH = "/opt/${DISTRO}/${SDK_VERSION}"

# Default timezone
DEFAULT_TIMEZONE ?= "Europe/Berlin"

# Locale support
IMAGE_LINGUAS ?= "en-us"

# Neutrino flavour selection
FLAVOUR ?= "tuxbox"

# Additional DISTRO-specific packages
DISTRO_EXTRA_RDEPENDS += " \
    "

DISTRO_EXTRA_RRECOMMENDS += " \
    "

# Drop Enigma2-only extras pulled in by OE-Alliance machine configs
EXTRA_IMAGEDEPENDS:remove = "enigma2-plugin-systemplugins-remotecontrolcode"
MACHINE_EXTRA_RDEPENDS:remove = "enigma2-plugin-systemplugins-remotecontrolcode"

# Build type
DISTRO_TYPE ?= "release"

# Release build settings
INHERIT += "${@bb.utils.contains('DISTRO_TYPE', 'release', 'rm_work', '', d)}"

# Development build settings
INHERIT += "${@bb.utils.contains('DISTRO_TYPE', 'development', 'buildhistory buildstats', '', d)}"
BUILDHISTORY_COMMIT ?= "1"

# Version information
TUXBOX_VERSION = "${DISTRO_VERSION}"
TUXBOX_BUILD_DATE = "${DATETIME}"
TUXBOX_BUILD_DATE[vardepsexclude] = "DATETIME"

# Force masking of Enigma2/OE-A distro content after machine configs are parsed
BBMASK:append = "|.*/oe-alliance/meta-oe/recipes-distros/.*|.*/oe-alliance/meta-oe/recipes-oe-alliance/enigma2-plugins/.*|.*/oe-alliance/meta-oe/recipes-oe-alliance/enigma2-skins.*|.*/oe-alliance/meta-oe/recipes-oe-alliance/enigma2-.*|.*/oe-alliance/meta-oe/.*enigma2.*|.*/enigma2-plugin-skins-.*|.*/enigma2-plugin-extensions-tuxcom.*|.*/hotplug-e2-helper.*|.*/enigma2-plugin-softcams-.*|.*/meta-oe/recipes-oe-alliance/enigma2/.*|.*/oe-alliance/meta-oe/recipes-oe-alliance/enigma2/.*|.*/oe-alliance/meta-oe/recipes-oe-alliance/enigma2-skins/.*|.*/aio-grab.*|.*/enigma2-plugin-skins.*|.*/enigma2-plugin-skins-kiddac-1080-slyk-r19.*|.*/enigma2-plugins/.*|.*/enigma2-plugin-.*|.*/enigma2-pliplugins.*|.*/gstreamer1.0-plugin-subsink.*|.*/gstreamer1.0-plugin-dvbmediasink.*|.*/jedimakerxtream.*|.*/recipes-qt5.15/qt5/.*|.*/meta-neutrino/recipes-qt/qt5/.*|.*/oe-alliance/meta-oe/recipes-devtools/gcc/.*11.2.*|.*/edid-decode.*"
BBMASK:append = "|.*/meta-neutrino/recipes-local/samba/.*"
BBMASK:append = "|.*/neutrino-hd-cs2_.*"
BBMASK:append = "|.*/oe-alliance/meta-oe/recipes-oe-alliance/image/oe-alliance-branding.bb"
BBMASK:append = "|.*/oe-alliance/meta-oe/recipes-oe-alliance/image/oe-alliance-branding-remote.bb"
BBMASK:append = "${@'' if d.getVar('MACHINE') in ['osnino', 'osninoplus', 'osninopro', 'osmini4k', 'osmio4k', 'osmio4kplus'] else '|.*/oe-alliance/meta-brands/meta-edision/recipes-linux/linux-edision_.*\\.bb|.*/meta-tuxbox/recipes-linux/linux-edision/.*\\.bbappend'}"
# Mask Qt5 appends while Qt5 base recipes are not part of the build
BBMASK:append = "|.*/meta-tuxbox/recipes-qt/qt5/.*\\.bbappend"
# Mask OA recipes/appends that are not part of the Tuxbox-Neutrino distro.
BBMASK:append = "|.*/oe-alliance/meta-oe/recipes-core/base-files/base-files_3.0.14.bbappend"
BBMASK:append = "|.*/oe-alliance/meta-oe/recipes-devtools/python/python3-youtube-dl.*"
# Optional: mask Kodi recipes for builds that do not carry Kodi support.
TUXBOX_MASK_KODI ?= "0"
BBMASK:append = "${@'|.*/oe-alliance/.*kodi.*|.*/meta-brands/.*/recipes-kodi/.*|.*/meta-tuxbox/recipes-kodi/.*|.*/meta-tuxbox/recipes-multimedia/kodi.*|.*/meta-tuxbox/recipes-multimedia/kodi-addons.*|.*/meta-tuxbox/recipes-multimedia/kodiext.*' if d.getVar('TUXBOX_MASK_KODI') == '1' else ''}"

# Drop OE-Alliance Enigma2 recipe globs before recipe discovery. This mirrors
# the distro-level BBMASK but avoids parsing recipes that should never
# participate in Tuxbox-Neutrino builds.
BBFILES := "${@' '.join([f for f in (d.getVar('BBFILES') or '').split() if not any(x in f for x in ['recipes-oe-alliance/enigma2', 'recipes-oe-alliance/enigma2-plugins', 'recipes-oe-alliance/enigma2-skins', 'recipes-oe-alliance/enigma2-dvb-drivers'])])}"
BBFILES:oe-alliance-layer := "${@' '.join([f for f in (d.getVar('BBFILES:oe-alliance-layer') or '').split() if not any(x in f for x in ['recipes-oe-alliance/enigma2', 'recipes-oe-alliance/enigma2-plugins', 'recipes-oe-alliance/enigma2-skins', 'recipes-distros', 'softcams'])])}"
```
